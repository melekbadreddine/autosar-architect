AUTOSAR XML (schema 4-2-2)
package /Default
  sender receiver interface IComCTR_EL_R
    data CTR_FN_DR: type=IComLight_Ctrl_Inputs_CTR_FN_DR_Type
    data CTR_FN_POS: type=IComLight_Ctrl_Inputs_CTR_FN_POS_Type
    data CTR_FN_PAR: type=IComLight_Ctrl_Inputs_CTR_FN_PAR_Type
